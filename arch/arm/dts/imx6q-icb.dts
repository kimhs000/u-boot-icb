// SPDX-License-Identifier: GPL-2.0+
//
// Copyright 2019 Naimtechnology
// Copyright 2012 Freescale Semiconductor, Inc.
// Copyright 2011 Linaro Ltd.

/dts-v1/;

#include "imx6q.dtsi"
#include "imx6qdl-icb.dtsi"

/ {
	model = "Naimtechnology i.MX6 Quad ICB Board";
	compatible = "fsl,imx6q-icb", "fsl,imx6q";
};

&sata {
	status = "okay";
};

&ipu1_csi1_from_mipi_vc1 {
	clock-lanes = <0>;
	data-lanes = <1 2>;
};
